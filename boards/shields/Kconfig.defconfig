## boards/shields/Kconfig.defconfig
```kconfig
if SHIELD_SILVERHAND_LEFT

# Name must be less than 16 characters long!
config ZMK_KEYBOARD_NAME
    default "silverhand"

config ZMK_SPLIT_ROLE_CENTRAL
    default y

endif

if SHIELD_SILVERHAND_LEFT || SHIELD_SILVERHAND_RIGHT

config ZMK_SPLIT
    default y

endif
```

## boards/shields/Kconfig.shield
```kconfig
config SHIELD_SILVERHAND_LEFT
    def_bool $(shields_list_contains,silverhand_left)


config SHIELD_SILVERHAND_RIGHT
    def_bool $(shields_list_contains,silverhand_right)
```

## config/boards/shields/Kconfig.defconfig
```kconfig
if SHIELD_SILVERHAND_LEFT


config ZMK_KEYBOARD_NAME
    default "silverhand"

config ZMK_SPLIT_ROLE_CENTRAL
    default y

endif

if SHIELD_SILVERHAND_LEFT || SHIELD_SILVERHAND_RIGHT

config ZMK_SPLIT
    default y

endif
```

## config/boards/shields/Kconfig.shield
```kconfig
# No whitespace after the comma or in your part name!
config SHIELD_SILVERHAND_LEFT
    def_bool $(shields_list_contains,silverhand_left)

# No whitespace after the comma or in your part name!
config SHIELD_SILVERHAND_RIGHT
    def_bool $(shields_list_contains,silverhand_right)
```
